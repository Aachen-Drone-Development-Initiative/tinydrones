## remote/sdkconfig.defaults
```kconfig
CONFIG_IDF_TARGET="esp32c6"
CONFIG_FREERTOS_HZ=1000
CONFIG_USJ_ENABLE_USB_SERIAL_JTAG=y
```

## tinydrone/components/adc/Kconfig
```kconfig
menu "ADC configuration"
    config BATTERY_GUARD
        bool "Enable Battery Guard"
        default y
        help 
            Enables periodic checks of battery charge and shutsdown when low.

    config BATTERY_MIN #IMPORTANT gives mV value as float is not supported
        int "Minimum Voltage"
        depends on BATTERY_GUARD
        default 3100
        help
            Number given in mV as Kconfig v2 which is currently in use does not support float

    config BATTERY_CHECK_PERIOD
        int "Battery check period"
        default 5000
        help 
          Number of ms between automatic battery voltage checks
endmenu
```

## tinydrone/components/motor_driver/Kconfig
```kconfig
menu "Motor Control"
    config MOTOR_DRIVER_ARMED_DUTY_CYCLE
        int "Motor duty cycle while armed"
        default 100
        help 
            The duty cycle while armed, but at 0 thrust. From 0 - MAX_DUTY_CYCLE.

    config MOTOR_DRIVER_MAX_DUTY_CYCLE 
        int "Max duty cycle"
        default 8192
        help
            Maximum Duty cycle. From 0 - 2^DUTY_CYCLE_RESOLUTION. Probably, 2^13=8192 is smart.

    config MOTOR_DRIVER_PWM_FREQUENCY
        int "Motor driver pwm frequency in hz"
        default 4000
        help 
            Frequency of the PWM signal for the Motors. idk what the bounds are.
endmenu
```
